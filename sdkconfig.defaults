## sdkconfig.defaults
```kconfig
# Partition Table
CONFIG_PARTITION_TABLE_CUSTOM=y
CONFIG_PARTITION_TABLE_CUSTOM_FILENAME="partitions.csv"

# Flash
CONFIG_ESPTOOLPY_FLASHSIZE_4MB=y

# FreeRTOS
CONFIG_FREERTOS_HZ=1000

# HTTP Server
CONFIG_HTTPD_MAX_REQ_HDR_LEN=1024
CONFIG_HTTPD_MAX_URI_LEN=512

# OTA
CONFIG_ESP_HTTPS_OTA_ALLOW_HTTP=y

# Log
CONFIG_LOG_DEFAULT_LEVEL_INFO=y
```
